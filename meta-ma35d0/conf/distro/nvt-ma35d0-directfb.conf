## meta-ma35d0/conf/distro/nvt-ma35d0-directfb.conf
```bitbake
# Nuvoton DISTRO for the FrameBuffer graphical backend.
include conf/distro/include/nvt-base.inc
DISTRO = "nvt-ma35d0-directfb"
```

## meta-ma35d0/conf/distro/nvt-ma35d0-weston.conf
```bitbake
# Nuvoton DISTRO for the FrameBuffer graphical backend.
include conf/distro/include/nvt-base.inc
DISTRO = "nvt-ma35d0-weston"

DISTRO_FEATURES:append = " wayland pam"
IMAGE_INSTALL:append = " weston libdrm libdrm-tests"

# Enabling weston-examples need to enable opengl/mesa
DISTRO_FEATURES:append = " opengl"
IMAGE_INSTALL:append = " weston-examples mesa"
```

## meta-ma35d1/conf/distro/include/nvt-base.inc
```bitbake
# ma35d1 DISTRO for the FrameBuffer graphical backend.
MAINTAINER = "Nuvoton <www.nuvoton.com>"
DISTRO = "nvt-ma35d1"
DISTRO_NAME = "Nuvoton Release Distro"
DISTRO_CODENAME = "scarthgap"
DISTRO_VERSION = "5.0-scarthgap"
SDK_VENDOR = "-pokysdk"
SDK_VERSION := "${DISTRO_VERSION}"
TARGET_VENDOR = "-poky"
TARGET_FPU = "hard"
BUILD_64BIT_KERNEL = "1"
require conf/multilib.conf
MULTILIBS ?= "multilib:lib64"
DEFAULTTUNE:virtclass-multilib-lib64 = "armv8a"
PREFERRED_PROVIDER:udev = "systemd"
PREFERRED_PROVIDER:udev-utils = "systemd"
INIT_MANAGER = "systemd"
DISTRO_FEATURES ?= "alsa vc8000"
```

## meta-ma35d1/conf/layer.conf
```bitbake
# We have a conf and classes directory, add to BBPATH
BBPATH .= ":${LAYERDIR}"

BBFILE_COLLECTIONS += "ma35d1-layer"
BBFILE_PATTERN_ma35d1-layer := "^${LAYERDIR}/"
BBFILE_PRIORITY_ma35d1-layer = "8"

# We have a recipes-* directories, add to BBFILES
BBFILES += "${LAYERDIR}/recipes-*/*/*.bb \
            ${LAYERDIR}/recipes-*/*/*.bbappend"

NTOOL = "${BSPDIR}/sources/meta-ma35d1/classes/scripts/nvt_tool.py"

BBPATH .= ":${LAYERDIR}/recipes-images"
# This should only be incremented on significant changes that will
# cause compatibility issues with other layers
LAYERSERIES_COMPAT_ma35d1-layer = " scarthgap"
LAYERVERSION_ma35d1-layer = "1"

# for optee-os-ma35d1 dependency
LAYERDEPENDS_ma35d1-layer = "core openembedded-layer meta-python"
CORE_IMAGE_EXTRA_INSTALL += " ${@bb.utils.contains('IMAGE_FSTYPES', 'sdcard', 'e2fsprogs-resize2fs e2fsprogs-mke2fs parted', '', d)} "
CORE_IMAGE_EXTRA_INSTALL += " ${@bb.utils.contains('IMAGE_FSTYPES', 'spinand', 'mtd-utils-ubifs', '', d)} "
CORE_IMAGE_EXTRA_INSTALL += " ${@bb.utils.contains('IMAGE_FSTYPES', 'nand', 'mtd-utils-ubifs', '', d)} "
CORE_IMAGE_EXTRA_INSTALL += " ${@bb.utils.contains('MACHINE_FEATURES', 'optee', 'optee-client optee-examples optee-test', '', d)} "
CORE_IMAGE_EXTRA_INSTALL += " ${@bb.utils.contains('DISTRO_FEATURES', 'alsa', 'alsa-utils', '', d)} "
CORE_IMAGE_EXTRA_INSTALL += " ${@bb.utils.contains('DISTRO_FEATURES', 'directfb', 'directfb', '', d)} "
CORE_IMAGE_EXTRA_INSTALL += " ${@bb.utils.contains('DISTRO_FEATURES', 'vc8000', 'vc8000', '', d)} "


DISTRO_FEATURES:append = " opengl"
IMAGE_INSTALL:append = " mesa mesa-dev"
```
