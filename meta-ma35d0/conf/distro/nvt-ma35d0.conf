## meta-ma35d1/conf/distro/nvt-ma35d1-directfb.conf
```bitbake
# Nuvoton DISTRO for the FrameBuffer graphical backend.
include conf/distro/include/nvt-base.inc
DISTRO = "nvt-ma35d1-directfb"
M4_OPJCOPY = "${RECIPE_SYSROOT_NATIVE}${datadir}/gcc-arm-none-eabi/arm-none-eabi/bin/objcopy"
DISTRO_FEATURES:append = "${@' gc520' if d.getVar('KERNEL_VERSION') == '6.6.93' else ''}"
DISTRO_FEATURES:append = "${@' vc8000' if d.getVar('KERNEL_VERSION') == '6.6.93' else ''}"
```
